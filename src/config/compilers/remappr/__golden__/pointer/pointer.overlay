/*
 * Pointer — Remappr shield (generated by remappr).
 *
 * Drop this directory into a remappr-firmware checkout under
 * boards/shields/pointer/ and build with -DSHIELD=pointer. Verify the
 * row/col GPIO specs against your wiring — remappr derives the matrix
 * cells from physical key position, not the electrical matrix.
 *
 * SPDX-License-Identifier: Apache-2.0
 */

#include <zephyr/dt-bindings/input/input-event-codes.h>
#include <zephyr/dt-bindings/input/keymap.h>
#include <dt-bindings/remappr/keys.h>
#include <dt-bindings/remappr/layout.h>
#include <remappr/keymap-tokens.dtsi>
#include <remappr/behavior-tokens.dtsi>
#include <dt-bindings/remappr/sensor.h>

&arduino_spi {
	status = "okay";
	cs-gpios = <&gpio1 12 GPIO_ACTIVE_LOW>;

	remappr_sensor: paw3395@0 {
		compatible = "pixart,paw3395";
		reg = <0>;
		spi-max-frequency = <8000000>;
		motion-gpios = <&gpio1 10 (GPIO_ACTIVE_LOW | GPIO_PULL_UP)>;
		reset-gpios = <&gpio1 11 GPIO_ACTIVE_LOW>;
		zephyr,axis-x = <INPUT_REL_X>;
		zephyr,axis-y = <INPUT_REL_Y>;
		remappr,setting-defaults = <
			REMAPPR_SENSOR_LIFT_CUTOFF 20
			REMAPPR_SENSOR_ANGLE_SNAP 1
		>;
	};
};
